/* -----------------------------------------------------------------------------
 * BlueBoard
 * I-Grebot
 * -----------------------------------------------------------------------------
 * @file       shell.c
 * @author     Bebop35
 * @date       Dec 04, 2016
 * -----------------------------------------------------------------------------
 * @brief
 *   FreeRTOS CLI Shell task
 * -----------------------------------------------------------------------------
 * Versionning informations
 * Repository: https://github.com/I-Grebot/blueboard.git
 * -----------------------------------------------------------------------------
 */

/* Inclusions */
#include "main.h"

/* Private functions and variables */
static void shell_task (void *pvParameters);

static const char * const pcWelcomeMessage 		  = WELCOME_MESSAGE;
static const char * const pcEndOfOutputMessage 	= SHELL_END_OF_OUTPUT_STR;
static const char * const pcNewLine 			      = SHELL_EOL;

/* Used to guard access to the UART in case messages are sent to the UART from
more than one task. */
static SemaphoreHandle_t xTxMutex = NULL;

OS_SHL_ConfigTypeDef OS_SHL_Config;

/* -----------------------------------------------------------------------------
 * Shell creation
 * -----------------------------------------------------------------------------
 */

BaseType_t shell_start(void)
{
    /* Reference to the support function for float printf */
    asm (".global _printf_float");

	/* Create the semaphore used to access the UART Tx. */
	xTxMutex = xSemaphoreCreateMutex();
	configASSERT( xTxMutex );

	/* Register Shell Commands */
	shell_register_commands();

	/* Initialize configuration with default settings */
	OS_SHL_Config.echo = true;

	/* Create that task that handles the console itself. */
	xTaskCreate( 	shell_task,				/* The task that implements the command console. */
					"SHELL",	    			    /* Text name assigned to the task.  This is just to assist debugging.  The kernel does not use this name itself. */
					OS_TASK_STACK_SHELL,		/* The size of the stack allocated to the task. */
					NULL,						        /* The parameter is not used, so NULL is passed. */
					OS_TASK_PRIORITY_SHELL,	/* The priority allocated to the task. */
					NULL );						      /* A handle is not required, so just pass NULL. */

	return pdPASS;
}

/* -----------------------------------------------------------------------------
 * Shell Task
 * -----------------------------------------------------------------------------
 */

static void shell_task(void *pvParameters)
{
	char cRxedChar;
	uint8_t ucInputIndex = 0;
	char *pcOutputString;
	static char cInputString[ SHELL_MAX_INPUT_SIZE ], cLastInputString[ SHELL_MAX_INPUT_SIZE ];
	BaseType_t xReturned;

	( void ) pvParameters;

	/* Obtain the address of the output buffer.  Note there is no mutual
	exclusion on this buffer as it is assumed only one command console interface
	will be used at any one time. */
	pcOutputString = FreeRTOS_CLIGetOutputBuffer();

	/* Send the welcome message. */
	serial_puts(pcWelcomeMessage);

	for( ;; )
	{
		/* Wait for the next character.  The while loop is used in case
		INCLUDE_vTaskSuspend is not set to 1 - in which case the RX Timeout will
		be a genuine block time rather than an infinite block time. */
		while( serial_get(&cRxedChar) != pdPASS );

		/* Ensure exclusive access to the UART Tx. */
		if( xSemaphoreTake( xTxMutex, SHELL_MAX_MUTEX_WAIT ) == pdPASS )
		{
			/* Echo the character back. */
			//if(OS_SHL_Config.echo) {
			    serial_put(cRxedChar);
			//}

			/* Was it the end of the line? */
			if( cRxedChar == '\n' || cRxedChar == '\r' )
			{
				/* Just to space the output from the input. */
			    //if(OS_SHL_Config.echo) {
			        serial_puts(pcNewLine);
			    //}

				/* See if the command is empty, indicating that the last command
				is to be executed again. */
				if( ucInputIndex == 0 )
				{
					/* Copy the last command back into the input string. */
					strcpy( cInputString, cLastInputString );
				}

				/* Pass the received command to the command interpreter.  The
				command interpreter is called repeatedly until it returns
				pdFALSE	(indicating there is no more output) as it might
				generate more than one string. */
				do
				{
					/* Get the next output string from the command interpreter. */
					xReturned = FreeRTOS_CLIProcessCommand( cInputString, pcOutputString, configCOMMAND_INT_MAX_OUTPUT_SIZE );

					/* Write the generated string to the UART. */
					serial_puts(pcOutputString);

				} while( xReturned != pdFALSE );

				/* All the strings generated by the input command have been
				sent.  Clear the input string ready to receive the next command.
				Remember the command that was just processed first in case it is
				to be processed again. */
				strcpy( cLastInputString, cInputString );
				ucInputIndex = 0;
				memset( cInputString, 0x00, SHELL_MAX_INPUT_SIZE );

				//if(OS_SHL_Config.echo) {
				serial_puts(pcEndOfOutputMessage);
				//}
			}
			else
			{
				if( cRxedChar == '\r' )
				{
					/* Ignore the character. */
				}
				else if( ( cRxedChar == '\b' ) || ( cRxedChar == SHELL_ASCII_DEL ) )
				{
					/* Backspace was pressed.  Erase the last character in the
					string - if any. */
					if( ucInputIndex > 0 )
					{
						ucInputIndex--;
						cInputString[ ucInputIndex ] = '\0';
					}
				}
				else
				{
					/* A character was entered.  Add it to the string entered so
					far.  When a \n is entered the complete	string will be
					passed to the command interpreter. */
					if( ( cRxedChar >= ' ' ) && ( cRxedChar <= '~' ) )
					{
						if( ucInputIndex < SHELL_MAX_INPUT_SIZE )
						{
							cInputString[ ucInputIndex ] = cRxedChar;
							ucInputIndex++;
						}
					}
				}
			}

			/* Must ensure to give the mutex back. */
			xSemaphoreGive( xTxMutex );
		}
	}
}

/* -----------------------------------------------------------------------------
 * Helpers and other public functions
 * -----------------------------------------------------------------------------
 */

void shell_print( const char * const pcMessage )
{
	if( xSemaphoreTake( xTxMutex, SHELL_MAX_MUTEX_WAIT ) == pdPASS )
	{
	    serial_puts(pcMessage);
		xSemaphoreGive( xTxMutex );
	}
}

/*-----------------------------------------------------------*/

